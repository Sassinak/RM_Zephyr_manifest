## CMakeLists.txt
```
cmake_minimum_required(VERSION 3.20)

set(BOARD damiao_mc02)
find_package(Zephyr REQUIRED HINTS $ENV{ZEPHYR_BASE})
project(buzzer)

list(APPEND DTC_BINDINGS_DIRS
    /home/sassinak/Engineer-workspace/Engineer-manifest/dts/bindings/buzzer
)

target_sources(app PRIVATE 
    src/main.c
    /home/sassinak/Engineer-workspace/Engineer-manifest/drivers/buzzer/MLT5020_pwm.c
)
target_include_directories(app PRIVATE include)

target_include_directories(app PRIVATE
    include
    /home/sassinak/Engineer-workspace/Engineer-manifest/drivers/buzzer
)
```

## Kconfig
```
source "Kconfig.zephyr"
source "../../Engineer-manifest/drivers/buzzer/Kconfig"
```

## prj.conf
```kconfig
CONFIG_PWM=y
# CONFIG_PWM_STM32=y
CONFIG_BUZZER=y
# CONFIG_LED=y
CONFIG_CPP=y

# RTT (Real-Time Transfer) Configuration
CONFIG_ASSERT=y
CONFIG_USE_SEGGER_RTT=y
CONFIG_CONSOLE=y
CONFIG_RTT_CONSOLE=y
CONFIG_UART_CONSOLE=n

# Optional: Enable RTT logging backend
CONFIG_LOG=y
CONFIG_LOG_BACKEND_RTT=y
CONFIG_LOG_BACKEND_UART=n

CONFIG_LOG=y
```

## src/main.c
```c
#include "song_lib.h"
#include <drivers/buzzer.h>
#include <zephyr/kernel.h>
#include <zephyr/device.h>
#include <zephyr/logging/log.h>
// #include <zephyr/drivers/pwm.h>

LOG_MODULE_REGISTER(buzzer, LOG_LEVEL_INF);

// 使用别名，指向当前 DTS 的蜂鸣器节点（rp,buzzer 或 pwm-leds 子节点的 alias）
#define BUZZER_NODE DT_ALIAS(buzzer0)
#if !DT_NODE_HAS_STATUS_OKAY(BUZZER_NODE)
#error "DT alias 'buzzer0' 未定义或禁用"
#endif

static const struct device *buzzer;

int buzzer_init(void)
{
    buzzer = DEVICE_DT_GET(BUZZER_NODE);
    if (!device_is_ready(buzzer)) {
        __ASSERT(false, "Buzzer device not ready");
        return ENODEV;
    }
    LOG_INF("Buzzer is ready!");
    return 0;
}

int main(void)
{
    buzzer_init();

    while (1)
    {
        buzzer_play_song(buzzer, &song_YOU);
        k_sleep(K_SECONDS(5));
    }
    return 0;
}
```
