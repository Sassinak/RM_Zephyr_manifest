## Kconfig
```kconfig
rsource "drivers/buzzer/Kconfig"
rsource "drivers/can_rx_manager/Kconfig"
rsource "drivers/can_tx_manager/Kconfig"
rsource "drivers/motor/Kconfig"
```

## drivers/can_rx_manager/Kconfig
```kconfig
# SPDX-License-Identifier: Apache-2.0
# Copyright (c) 2025 Sassinak
menuconfig CAN_RX_MANAGER
    bool "CAN RX manager"
    default n
    depends on CAN
    help
      Enable per-CAN-bus RX manager which receives frames into a message queue and dispatches
      them to registered software handlers.

if CAN_RX_MANAGER

config CAN_RX_MANAGER_INIT_PRIORITY
        int "Init priority"
        default 90
        range 0 99
        help
            Device init priority for the CAN RX manager.
            Must be greater (later) than the CAN controller init priority.

config CAN_RX_MANAGER_MAX_LISTENERS
    int "Max number of registered listeners"
    default 64
    range 1 256

config CAN_RX_MANAGER_RX_MSGQ_LEN
    int "RX message queue length"
    default 128
    range 4 1024

config CAN_RX_MANAGER_RX_STACK_SIZE
    int "RX thread stack size"
    default 2048
    range 512 16384

config CAN_RX_MANAGER_RX_THREAD_PRIO
    int "RX thread priority (lower is higher)"
    default 2
    range 0 15

config CAN_RX_MANAGER_MSGQ_MONITOR
        bool "Monitor RX msgq drops (msgq full)"
        default n
        help
            Counts CAN frames dropped because the RX message queue is full (k_msgq_put() failed from
            ISR context). The RX thread will log warnings when drops occur.

config CAN_RX_MANAGER_MSGQ_WARN_EVERY_N_DROPS
        int "Warn every N dropped frames"
        default 1
        range 1 1000000
        depends on CAN_RX_MANAGER_MSGQ_MONITOR
        help
            Emit a LOG_WRN each time the cumulative drop counter increases by N.

endif # CAN_RX_MANAGER
```

## drivers/motor/Kconfig
```kconfig
menuconfig MOTOR
    bool "Motor drivers"
    default n
    depends on CAN
    select CAN_RX_MANAGER

if MOTOR

config MOTOR_INIT_PRIORITY
        int "Init priority"
        default 91
        range 0 99
        help
            Device init priority for motor drivers.
            Must be greater (later) than the CAN controller init priority.

config MOTOR_LOG_LEVEL
    int "Motor log level"
    default 3
    range 0 4
    help
      Log level for motor drivers (0=none, 4=debug).

endif # MOTOR
```

## dts/bindings/buzzer/RP,pwm-buzzer.yaml
```yaml
# Copyright (c) 2025 Sassinak
# SPDX-License-Identifier: Apache-2.0

description: 
  Custom PWM-controlled Buzzer

compatible: "RP,pwm-buzzer"

properties:
  pwms:
    required: true
    type: phandle-array
    description: |
      Reference to a PWM instance.

      The period field is used by the set_brightness function of the LED API.
      Its value should at least be greater that 100 nanoseconds (for a full
      brightness granularity) and lesser than 50 milliseconds (average visual
      persistence time of the human eye). Typical values for the PWM period
      are 10 or 20 milliseconds.
  label:
    type: string
    description: |
      Human readable string describing the Buzzer. It can be used by an
      application to identify this Buzzer or to retrieve its number/index
      (i.e. child node number) on the parent device.
```

## dts/bindings/motor/rp,can-motor.yaml
```yaml
# Copyright (c) 2025 Sassinak
# SPDX-License-Identifier: Apache-2.0

description: 
  Custom CAN-controlled Motor instance

compatible: "rp,can-motor"

properties:

  can-bus:
    type: phandle
    required: true
    description: |
      Reference to the CAN controller used to communicate with this motor.
      On STM32H7 this is typically one of: &fdcan1, &fdcan2, &fdcan3
      (compatible "st,stm32h7-fdcan").

  tx-id:
    type: int
    required: true
    description: |
      CAN identifier used when sending commands to the motor.
      By default this is interpreted as an 11-bit (standard) ID unless
      the 'extended-id' property is present.

  rx-id:
    type: int
    required: true
    description: |
      CAN identifier expected in frames received from the motor.
      If omitted, the driver may assume it is the same as 'tx-id' or
      derive it from the motor model.

  can-fd:
    type: boolean
    description: |
      Enable CAN FD framing for this motor (up to 64 data bytes).
      If absent, classic CAN (up to 8 data bytes) is assumed.

  motor-id:
    type: string
    required: true
    description: |
      Identifier of the motor type. this is the unique id of motor!!!. ex: "chassis_FL"

  motor-type:
    type: string
    enum:
      - "dji"   # 大疆电机
      - "lk"    # 瓴控电机
      - "dm"    # 达妙电机
      - "ht"    # 海泰电机
      - "bm"    # 本末电机
    required: true
    description: |
      Type of the motor. 

  control-mode:
    type: string
    enum:
      - "torque"                # 扭矩控制模式
      - "velocity"              # 速度控制模式
      - "position"              # 位置控制模式
      - "velocity_position"     # 速度+位置控制模式
      - "MIT"                   # MIT控制模式
    description: |
      Control mode of the motor.

  label:
    type: string
    description: |
      Human readable string describing the motor instance.
```

## dts/bindings/motor/rp,dji-can-motor.yaml
```yaml
# Copyright (c) 2025 Sassinak
# SPDX-License-Identifier: Apache-2.0

description:
  Custom CAN-controlled DJI motor device.


compatible: "rp,dji-can-motor"

properties:
  can-bus:
    type: phandle
    required: true
    description: |
      Reference to the CAN controller used to communicate with the motor.
      On STM32H7 this is typically one of: &fdcan1, &fdcan2, &fdcan3.

  rx-manager:
    type: phandle
    required: false
    description: |
      Reference to a shared CAN RX manager (rp,can-rx-manager) bound to the same can-bus.
      When present, motor drivers should receive frames through the manager instead of
      creating their own RX threads/message queues.

  can-fd:
    type: boolean
    description: |
      Enable CAN FD framing for the motor (up to 64 data bytes).
      If absent, classic CAN (up to 8 data bytes) is assumed.

  label:
    type: string
    description: |
      Human readable string describing this motor.

  tx-id:
    type: int
    required: true
    description: |
      CAN identifier used when sending commands to the motor.
      By default this is interpreted as an 11-bit (standard) ID unless
      the 'extended-id' property is present.

  rx-id:
    type: int
    required: true
    description: |
      CAN identifier expected in frames received from the motor.

  motor-id:
    type: string
    required: true
    description: |
      Unique identifier string for application use (e.g. "chassis_FL").

  control-mode:
    type: string
    required: true
    enum:
      - "torque"                # 扭矩控制模式
      - "velocity"              # 速度控制模式
    description: |
      Control mode of the motor.
```

## samples/boards/damiao_mc02/button/build/Kconfig/Kconfig.modules
```kconfig
menu "Engineer-manifest (/home/sassinak/Engineer-workspace/Engineer-manifest)"
osource "/home/sassinak/Engineer-workspace/Engineer-manifest/Kconfig"
config ZEPHYR_ENGINEER_MANIFEST_MODULE
	bool
	default y
endmenu
menu "etl (/home/sassinak/Engineer-workspace/Engineer-sdk/modules/lib/etl)"
osource "/home/sassinak/Engineer-workspace/Engineer-sdk/modules/lib/etl/zephyr/Kconfig"
config ZEPHYR_ETL_MODULE
	bool
	default y
endmenu
menu "cmsis (/home/sassinak/Engineer-workspace/Engineer-sdk/modules/hal/cmsis)"
osource "$(ZEPHYR_CMSIS_KCONFIG)"
config ZEPHYR_CMSIS_MODULE
	bool
	default y
endmenu
menu "cmsis-dsp (/home/sassinak/Engineer-workspace/Engineer-sdk/modules/lib/cmsis-dsp)"
osource "$(ZEPHYR_CMSIS_DSP_KCONFIG)"
config ZEPHYR_CMSIS_DSP_MODULE
	bool
	default y
endmenu
menu "cmsis-nn (/home/sassinak/Engineer-workspace/Engineer-sdk/modules/lib/cmsis-nn)"
osource "$(ZEPHYR_CMSIS_NN_KCONFIG)"
config ZEPHYR_CMSIS_NN_MODULE
	bool
	default y
endmenu
menu "cmsis_6 (/home/sassinak/Engineer-workspace/Engineer-sdk/modules/hal/cmsis_6)"
osource "$(ZEPHYR_CMSIS_6_KCONFIG)"
config ZEPHYR_CMSIS_6_MODULE
	bool
	default y
endmenu
menu "hal_st (/home/sassinak/Engineer-workspace/Engineer-sdk/modules/hal/st)"
osource "$(ZEPHYR_HAL_ST_KCONFIG)"
config ZEPHYR_HAL_ST_MODULE
	bool
	default y
endmenu
config ZEPHYR_HAL_STM32_MODULE
	bool
	default y

config ZEPHYR_HAL_STM32_MODULE_BLOBS
	bool
menu "segger (/home/sassinak/Engineer-workspace/Engineer-sdk/modules/debug/segger)"
osource "$(ZEPHYR_SEGGER_KCONFIG)"
config ZEPHYR_SEGGER_MODULE
	bool
	default y
endmenu
```

## samples/boards/damiao_mc02/button/build/Kconfig/Kconfig.shield
```kconfig
osource "/home/sassinak/Engineer-workspace/Engineer-manifest/boards/shields/*/Kconfig.shield"
```

## samples/boards/damiao_mc02/button/build/Kconfig/boards/Kconfig
```kconfig
# Load Zephyr board Kconfig descriptions.
osource "/home/sassinak/Engineer-workspace/Engineer-manifest/boards/damiao/mc02/Kconfig"
```

## samples/boards/damiao_mc02/button/build/Kconfig/boards/Kconfig.damiao_mc02
```kconfig
# Load board Kconfig descriptions.
osource "/home/sassinak/Engineer-workspace/Engineer-manifest/boards/damiao/mc02/Kconfig.damiao_mc02"
```
