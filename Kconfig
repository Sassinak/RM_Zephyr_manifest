## samples/boards/damiao_mc02/button/build/Kconfig/soc/Kconfig.sysbuild
```kconfig
# Load Sysbuild SoC Kconfig descriptions.
osource "/home/sassinak/Engineer-workspace/Engineer-sdk/zephyr/soc/xlnx/zynqmp/Kconfig.sysbuild"
osource "/home/sassinak/Engineer-workspace/Engineer-sdk/zephyr/soc/xlnx/zynq7000/Kconfig.sysbuild"
osource "/home/sassinak/Engineer-workspace/Engineer-sdk/zephyr/soc/xlnx/versalnet/Kconfig.sysbuild"
osource "/home/sassinak/Engineer-workspace/Engineer-sdk/zephyr/soc/xlnx/versal2/Kconfig.sysbuild"
osource "/home/sassinak/Engineer-workspace/Engineer-sdk/zephyr/soc/xen/Kconfig.sysbuild"
osource "/home/sassinak/Engineer-workspace/Engineer-sdk/zephyr/soc/wch/ch32v/Kconfig.sysbuild"
osource "/home/sassinak/Engineer-workspace/Engineer-sdk/zephyr/soc/ti/simplelink/Kconfig.sysbuild"
osource "/home/sassinak/Engineer-workspace/Engineer-sdk/zephyr/soc/ti/mspm0/Kconfig.sysbuild"
osource "/home/sassinak/Engineer-workspace/Engineer-sdk/zephyr/soc/ti/lm3s6965/Kconfig.sysbuild"
osource "/home/sassinak/Engineer-workspace/Engineer-sdk/zephyr/soc/ti/k3/Kconfig.sysbuild"
osource "/home/sassinak/Engineer-workspace/Engineer-sdk/zephyr/soc/telink/tlsr/Kconfig.sysbuild"
osource "/home/sassinak/Engineer-workspace/Engineer-sdk/zephyr/soc/starfive/jh71xx/Kconfig.sysbuild"
osource "/home/sassinak/Engineer-workspace/Engineer-sdk/zephyr/soc/st/stm32/Kconfig.sysbuild"
osource "/home/sassinak/Engineer-workspace/Engineer-sdk/zephyr/soc/snps/qemu_arc/Kconfig.sysbuild"
osource "/home/sassinak/Engineer-workspace/Engineer-sdk/zephyr/soc/snps/nsim/arc_v/Kconfig.sysbuild"
osource "/home/sassinak/Engineer-workspace/Engineer-sdk/zephyr/soc/snps/nsim/arc_classic/Kconfig.sysbuild"
osource "/home/sassinak/Engineer-workspace/Engineer-sdk/zephyr/soc/snps/hsdk4xd/Kconfig.sysbuild"
osource "/home/sassinak/Engineer-workspace/Engineer-sdk/zephyr/soc/snps/hsdk/Kconfig.sysbuild"
osource "/home/sassinak/Engineer-workspace/Engineer-sdk/zephyr/soc/snps/emsk/Kconfig.sysbuild"
osource "/home/sassinak/Engineer-workspace/Engineer-sdk/zephyr/soc/snps/emsdp/Kconfig.sysbuild"
osource "/home/sassinak/Engineer-workspace/Engineer-sdk/zephyr/soc/snps/arc_iot/Kconfig.sysbuild"
osource "/home/sassinak/Engineer-workspace/Engineer-sdk/zephyr/soc/silabs/Kconfig.sysbuild"
osource "/home/sassinak/Engineer-workspace/Engineer-sdk/zephyr/soc/sifive/sifive_freedom/Kconfig.sysbuild"
osource "/home/sassinak/Engineer-workspace/Engineer-sdk/zephyr/soc/sensry/Kconfig.sysbuild"
osource "/home/sassinak/Engineer-workspace/Engineer-sdk/zephyr/soc/rockchip/Kconfig.sysbuild"
osource "/home/sassinak/Engineer-workspace/Engineer-sdk/zephyr/soc/renode/riscv_virtual/Kconfig.sysbuild"
osource "/home/sassinak/Engineer-workspace/Engineer-sdk/zephyr/soc/renode/cortex_r8_virtual/Kconfig.sysbuild"
osource "/home/sassinak/Engineer-workspace/Engineer-sdk/zephyr/soc/renesas/smartbond/Kconfig.sysbuild"
osource "/home/sassinak/Engineer-workspace/Engineer-sdk/zephyr/soc/renesas/rz/Kconfig.sysbuild"
osource "/home/sassinak/Engineer-workspace/Engineer-sdk/zephyr/soc/renesas/rx/Kconfig.sysbuild"
osource "/home/sassinak/Engineer-workspace/Engineer-sdk/zephyr/soc/renesas/rcar/Kconfig.sysbuild"
osource "/home/sassinak/Engineer-workspace/Engineer-sdk/zephyr/soc/renesas/ra/Kconfig.sysbuild"
osource "/home/sassinak/Engineer-workspace/Engineer-sdk/zephyr/soc/realtek/ec/Kconfig.sysbuild"
osource "/home/sassinak/Engineer-workspace/Engineer-sdk/zephyr/soc/raspberrypi/rpi_pico/Kconfig.sysbuild"
osource "/home/sassinak/Engineer-workspace/Engineer-sdk/zephyr/soc/quicklogic/eos_s3/Kconfig.sysbuild"
osource "/home/sassinak/Engineer-workspace/Engineer-sdk/zephyr/soc/qemu/virt_riscv/Kconfig.sysbuild"
osource "/home/sassinak/Engineer-workspace/Engineer-sdk/zephyr/soc/qemu/malta/Kconfig.sysbuild"
osource "/home/sassinak/Engineer-workspace/Engineer-sdk/zephyr/soc/openisa/rv32m1/Kconfig.sysbuild"
osource "/home/sassinak/Engineer-workspace/Engineer-sdk/zephyr/soc/openhwgroup/cva6/Kconfig.sysbuild"
osource "/home/sassinak/Engineer-workspace/Engineer-sdk/zephyr/soc/oct/osd32mp15x/Kconfig.sysbuild"
osource "/home/sassinak/Engineer-workspace/Engineer-sdk/zephyr/soc/nxp/s32/Kconfig.sysbuild"
osource "/home/sassinak/Engineer-workspace/Engineer-sdk/zephyr/soc/nxp/rw/Kconfig.sysbuild"
osource "/home/sassinak/Engineer-workspace/Engineer-sdk/zephyr/soc/nxp/mcx/Kconfig.sysbuild"
osource "/home/sassinak/Engineer-workspace/Engineer-sdk/zephyr/soc/nxp/lpc/Kconfig.sysbuild"
osource "/home/sassinak/Engineer-workspace/Engineer-sdk/zephyr/soc/nxp/layerscape/Kconfig.sysbuild"
osource "/home/sassinak/Engineer-workspace/Engineer-sdk/zephyr/soc/nxp/kinetis/Kconfig.sysbuild"
osource "/home/sassinak/Engineer-workspace/Engineer-sdk/zephyr/soc/nxp/imxrt/Kconfig.sysbuild"
osource "/home/sassinak/Engineer-workspace/Engineer-sdk/zephyr/soc/nxp/imx/Kconfig.sysbuild"
osource "/home/sassinak/Engineer-workspace/Engineer-sdk/zephyr/soc/nuvoton/numicro/Kconfig.sysbuild"
osource "/home/sassinak/Engineer-workspace/Engineer-sdk/zephyr/soc/nuvoton/numaker/Kconfig.sysbuild"
osource "/home/sassinak/Engineer-workspace/Engineer-sdk/zephyr/soc/nuvoton/npcx/Kconfig.sysbuild"
osource "/home/sassinak/Engineer-workspace/Engineer-sdk/zephyr/soc/nuvoton/npcm/Kconfig.sysbuild"
osource "/home/sassinak/Engineer-workspace/Engineer-sdk/zephyr/soc/nordic/Kconfig.sysbuild"
osource "/home/sassinak/Engineer-workspace/Engineer-sdk/zephyr/soc/neorv32/Kconfig.sysbuild"
osource "/home/sassinak/Engineer-workspace/Engineer-sdk/zephyr/soc/native/inf_clock/Kconfig.sysbuild"
osource "/home/sassinak/Engineer-workspace/Engineer-sdk/zephyr/soc/microchip/sam/Kconfig.sysbuild"
osource "/home/sassinak/Engineer-workspace/Engineer-sdk/zephyr/soc/microchip/sam/sam_d5x_e5x/Kconfig.sysbuild"
osource "/home/sassinak/Engineer-workspace/Engineer-sdk/zephyr/soc/microchip/miv/Kconfig.sysbuild"
osource "/home/sassinak/Engineer-workspace/Engineer-sdk/zephyr/soc/microchip/mec/Kconfig.sysbuild"
osource "/home/sassinak/Engineer-workspace/Engineer-sdk/zephyr/soc/mediatek/mt8xxx/Kconfig.sysbuild"
osource "/home/sassinak/Engineer-workspace/Engineer-sdk/zephyr/soc/lowrisc/opentitan/Kconfig.sysbuild"
osource "/home/sassinak/Engineer-workspace/Engineer-sdk/zephyr/soc/litex/litex_vexriscv/Kconfig.sysbuild"
osource "/home/sassinak/Engineer-workspace/Engineer-sdk/zephyr/soc/ite/ec/Kconfig.sysbuild"
osource "/home/sassinak/Engineer-workspace/Engineer-sdk/zephyr/soc/intel/raptor_lake/Kconfig.sysbuild"
osource "/home/sassinak/Engineer-workspace/Engineer-sdk/zephyr/soc/intel/panther_lake/Kconfig.sysbuild"
osource "/home/sassinak/Engineer-workspace/Engineer-sdk/zephyr/soc/intel/lakemont/Kconfig.sysbuild"
osource "/home/sassinak/Engineer-workspace/Engineer-sdk/zephyr/soc/intel/intel_socfpga_std/Kconfig.sysbuild"
osource "/home/sassinak/Engineer-workspace/Engineer-sdk/zephyr/soc/intel/intel_socfpga/Kconfig.sysbuild"
osource "/home/sassinak/Engineer-workspace/Engineer-sdk/zephyr/soc/intel/intel_niosv/Kconfig.sysbuild"
osource "/home/sassinak/Engineer-workspace/Engineer-sdk/zephyr/soc/intel/intel_ish/Kconfig.sysbuild"
osource "/home/sassinak/Engineer-workspace/Engineer-sdk/zephyr/soc/intel/intel_adsp/Kconfig.sysbuild"
osource "/home/sassinak/Engineer-workspace/Engineer-sdk/zephyr/soc/intel/elkhart_lake/Kconfig.sysbuild"
osource "/home/sassinak/Engineer-workspace/Engineer-sdk/zephyr/soc/intel/atom/Kconfig.sysbuild"
osource "/home/sassinak/Engineer-workspace/Engineer-sdk/zephyr/soc/intel/apollo_lake/Kconfig.sysbuild"
osource "/home/sassinak/Engineer-workspace/Engineer-sdk/zephyr/soc/intel/alder_lake/Kconfig.sysbuild"
osource "/home/sassinak/Engineer-workspace/Engineer-sdk/zephyr/soc/infineon/cat3/Kconfig.sysbuild"
osource "/home/sassinak/Engineer-workspace/Engineer-sdk/zephyr/soc/infineon/cat1c/Kconfig.sysbuild"
osource "/home/sassinak/Engineer-workspace/Engineer-sdk/zephyr/soc/infineon/cat1b/Kconfig.sysbuild"
osource "/home/sassinak/Engineer-workspace/Engineer-sdk/zephyr/soc/infineon/cat1a/Kconfig.sysbuild"
osource "/home/sassinak/Engineer-workspace/Engineer-sdk/zephyr/soc/gd/gd32/Kconfig.sysbuild"
osource "/home/sassinak/Engineer-workspace/Engineer-sdk/zephyr/soc/gaisler/leon3/Kconfig.sysbuild"
osource "/home/sassinak/Engineer-workspace/Engineer-sdk/zephyr/soc/gaisler/gr716a/Kconfig.sysbuild"
osource "/home/sassinak/Engineer-workspace/Engineer-sdk/zephyr/soc/espressif/Kconfig.sysbuild"
osource "/home/sassinak/Engineer-workspace/Engineer-sdk/zephyr/soc/ene/kb1200/Kconfig.sysbuild"
osource "/home/sassinak/Engineer-workspace/Engineer-sdk/zephyr/soc/ene/kb106x/Kconfig.sysbuild"
osource "/home/sassinak/Engineer-workspace/Engineer-sdk/zephyr/soc/efinix/sapphire/Kconfig.sysbuild"
osource "/home/sassinak/Engineer-workspace/Engineer-sdk/zephyr/soc/cdns/xtensa_sample_controller/Kconfig.sysbuild"
osource "/home/sassinak/Engineer-workspace/Engineer-sdk/zephyr/soc/cdns/sample_controller32/Kconfig.sysbuild"
osource "/home/sassinak/Engineer-workspace/Engineer-sdk/zephyr/soc/cdns/dc233c/Kconfig.sysbuild"
osource "/home/sassinak/Engineer-workspace/Engineer-sdk/zephyr/soc/brcm/bcmvk/Kconfig.sysbuild"
osource "/home/sassinak/Engineer-workspace/Engineer-sdk/zephyr/soc/brcm/bcm2712/Kconfig.sysbuild"
osource "/home/sassinak/Engineer-workspace/Engineer-sdk/zephyr/soc/brcm/bcm2711/Kconfig.sysbuild"
osource "/home/sassinak/Engineer-workspace/Engineer-sdk/zephyr/soc/bflb/Kconfig.sysbuild"
osource "/home/sassinak/Engineer-workspace/Engineer-sdk/zephyr/soc/atmel/sam0/Kconfig.sysbuild"
osource "/home/sassinak/Engineer-workspace/Engineer-sdk/zephyr/soc/atmel/sam/Kconfig.sysbuild"
osource "/home/sassinak/Engineer-workspace/Engineer-sdk/zephyr/soc/aspeed/Kconfig.sysbuild"
osource "/home/sassinak/Engineer-workspace/Engineer-sdk/zephyr/soc/arm/Kconfig.sysbuild"
osource "/home/sassinak/Engineer-workspace/Engineer-sdk/zephyr/soc/arm/beetle/Kconfig.sysbuild"
osource "/home/sassinak/Engineer-workspace/Engineer-sdk/zephyr/soc/antmicro/myra/Kconfig.sysbuild"
osource "/home/sassinak/Engineer-workspace/Engineer-sdk/zephyr/soc/andestech/Kconfig.sysbuild"
osource "/home/sassinak/Engineer-workspace/Engineer-sdk/zephyr/soc/amd/acp_6_0/Kconfig.sysbuild"
osource "/home/sassinak/Engineer-workspace/Engineer-sdk/zephyr/soc/ambiq/Kconfig.sysbuild"
osource "/home/sassinak/Engineer-workspace/Engineer-sdk/zephyr/soc/aesc/Kconfig.sysbuild"
osource "/home/sassinak/Engineer-workspace/Engineer-sdk/zephyr/soc/adi/max32/Kconfig.sysbuild"
```

## samples/boards/damiao_mc02/ws2812/build/Kconfig/Kconfig.shield.defconfig
```kconfig
osource "/home/sassinak/Engineer-workspace/Engineer-manifest/boards/shields/*/Kconfig.defconfig"
```

## samples/boards/damiao_mc02/ws2812/build/Kconfig/arch/Kconfig
```kconfig
# Load Zephyr Arch Kconfig descriptions.
osource "/home/sassinak/Engineer-workspace/Engineer-sdk/zephyr/arch/rx/Kconfig"
osource "/home/sassinak/Engineer-workspace/Engineer-sdk/zephyr/arch/x86/Kconfig"
osource "/home/sassinak/Engineer-workspace/Engineer-sdk/zephyr/arch/xtensa/Kconfig"
osource "/home/sassinak/Engineer-workspace/Engineer-sdk/zephyr/arch/sparc/Kconfig"
osource "/home/sassinak/Engineer-workspace/Engineer-sdk/zephyr/arch/riscv/Kconfig"
osource "/home/sassinak/Engineer-workspace/Engineer-sdk/zephyr/arch/posix/Kconfig"
osource "/home/sassinak/Engineer-workspace/Engineer-sdk/zephyr/arch/mips/Kconfig"
osource "/home/sassinak/Engineer-workspace/Engineer-sdk/zephyr/arch/arm64/Kconfig"
osource "/home/sassinak/Engineer-workspace/Engineer-sdk/zephyr/arch/arm/Kconfig"
osource "/home/sassinak/Engineer-workspace/Engineer-sdk/zephyr/arch/arc/Kconfig"
```

## samples/boards/damiao_mc02/ws2812/build/Kconfig/boards/Kconfig.defconfig
```kconfig
# Load Zephyr board defconfig descriptions.
osource "/home/sassinak/Engineer-workspace/Engineer-manifest/boards/damiao/mc02/Kconfig.defconfig"
```

## west.yml
```yaml
manifest:

  defaults:
    remote: Sassinak                                     # 设置默认的remote，这样下面的project就可以不写remote字段

  remotes:                                                # 这里可以配置多个远程仓库 必须是复数                     
    - name: Sassinak                                      # 这个名字是为了方便后面项目配置时选择url路径
      url-base: https://github.com/Sassinak                # 注意这里并不是.git结尾,这里只是搜索路径的一部分，后面还需要跟项目名(Engineer)
    - name: Zephyr-RTOS
      url-base: https://github.com/zephyrproject-rtos     # 这里引入官方内核

  projects:
    - name: Engineer
      description: this is a test project,just to validate my study
      revision: develop                                      # 必须有个revision字段，因为west默认查找的分支是master，而github新建的仓库默认分支是main
      path: Engineer/RP_Engineer
    - name: zephyr
      remote: Zephyr-RTOS                                   # 项目内的remote必须是单数的
      revision: main
      path: zephyr                                   
      import:
        path-prefix: Engineer-sdk
        name-allowlist: 
          - cmsis
          - cmsis_6
          - cmsis-nn
          - cmsis-dsp
          - segger
          - hal_st
          - hal_stm32
        
  self:
    path: Engineer-manifest
    import: submanifests
```
