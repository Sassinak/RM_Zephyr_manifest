## samples/boards/damiao_mc02/button/build/Kconfig/soc/Kconfig
```kconfig
# Load Zephyr SoC Kconfig descriptions.
osource "/home/sassinak/Engineer-workspace/Engineer-sdk/zephyr/soc/xlnx/zynqmp/Kconfig"
osource "/home/sassinak/Engineer-workspace/Engineer-sdk/zephyr/soc/xlnx/zynq7000/Kconfig"
osource "/home/sassinak/Engineer-workspace/Engineer-sdk/zephyr/soc/xlnx/versalnet/Kconfig"
osource "/home/sassinak/Engineer-workspace/Engineer-sdk/zephyr/soc/xlnx/versal2/Kconfig"
osource "/home/sassinak/Engineer-workspace/Engineer-sdk/zephyr/soc/xen/Kconfig"
osource "/home/sassinak/Engineer-workspace/Engineer-sdk/zephyr/soc/wch/ch32v/Kconfig"
osource "/home/sassinak/Engineer-workspace/Engineer-sdk/zephyr/soc/ti/simplelink/Kconfig"
osource "/home/sassinak/Engineer-workspace/Engineer-sdk/zephyr/soc/ti/mspm0/Kconfig"
osource "/home/sassinak/Engineer-workspace/Engineer-sdk/zephyr/soc/ti/lm3s6965/Kconfig"
osource "/home/sassinak/Engineer-workspace/Engineer-sdk/zephyr/soc/ti/k3/Kconfig"
osource "/home/sassinak/Engineer-workspace/Engineer-sdk/zephyr/soc/telink/tlsr/Kconfig"
osource "/home/sassinak/Engineer-workspace/Engineer-sdk/zephyr/soc/starfive/jh71xx/Kconfig"
osource "/home/sassinak/Engineer-workspace/Engineer-sdk/zephyr/soc/st/stm32/Kconfig"
osource "/home/sassinak/Engineer-workspace/Engineer-sdk/zephyr/soc/snps/qemu_arc/Kconfig"
osource "/home/sassinak/Engineer-workspace/Engineer-sdk/zephyr/soc/snps/nsim/arc_v/Kconfig"
osource "/home/sassinak/Engineer-workspace/Engineer-sdk/zephyr/soc/snps/nsim/arc_classic/Kconfig"
osource "/home/sassinak/Engineer-workspace/Engineer-sdk/zephyr/soc/snps/hsdk4xd/Kconfig"
osource "/home/sassinak/Engineer-workspace/Engineer-sdk/zephyr/soc/snps/hsdk/Kconfig"
osource "/home/sassinak/Engineer-workspace/Engineer-sdk/zephyr/soc/snps/emsk/Kconfig"
osource "/home/sassinak/Engineer-workspace/Engineer-sdk/zephyr/soc/snps/emsdp/Kconfig"
osource "/home/sassinak/Engineer-workspace/Engineer-sdk/zephyr/soc/snps/arc_iot/Kconfig"
osource "/home/sassinak/Engineer-workspace/Engineer-sdk/zephyr/soc/silabs/Kconfig"
osource "/home/sassinak/Engineer-workspace/Engineer-sdk/zephyr/soc/sifive/sifive_freedom/Kconfig"
osource "/home/sassinak/Engineer-workspace/Engineer-sdk/zephyr/soc/sensry/Kconfig"
osource "/home/sassinak/Engineer-workspace/Engineer-sdk/zephyr/soc/rockchip/Kconfig"
osource "/home/sassinak/Engineer-workspace/Engineer-sdk/zephyr/soc/renode/riscv_virtual/Kconfig"
osource "/home/sassinak/Engineer-workspace/Engineer-sdk/zephyr/soc/renode/cortex_r8_virtual/Kconfig"
osource "/home/sassinak/Engineer-workspace/Engineer-sdk/zephyr/soc/renesas/smartbond/Kconfig"
osource "/home/sassinak/Engineer-workspace/Engineer-sdk/zephyr/soc/renesas/rz/Kconfig"
osource "/home/sassinak/Engineer-workspace/Engineer-sdk/zephyr/soc/renesas/rx/Kconfig"
osource "/home/sassinak/Engineer-workspace/Engineer-sdk/zephyr/soc/renesas/rcar/Kconfig"
osource "/home/sassinak/Engineer-workspace/Engineer-sdk/zephyr/soc/renesas/ra/Kconfig"
osource "/home/sassinak/Engineer-workspace/Engineer-sdk/zephyr/soc/realtek/ec/Kconfig"
osource "/home/sassinak/Engineer-workspace/Engineer-sdk/zephyr/soc/raspberrypi/rpi_pico/Kconfig"
osource "/home/sassinak/Engineer-workspace/Engineer-sdk/zephyr/soc/quicklogic/eos_s3/Kconfig"
osource "/home/sassinak/Engineer-workspace/Engineer-sdk/zephyr/soc/qemu/virt_riscv/Kconfig"
osource "/home/sassinak/Engineer-workspace/Engineer-sdk/zephyr/soc/qemu/malta/Kconfig"
osource "/home/sassinak/Engineer-workspace/Engineer-sdk/zephyr/soc/openisa/rv32m1/Kconfig"
osource "/home/sassinak/Engineer-workspace/Engineer-sdk/zephyr/soc/openhwgroup/cva6/Kconfig"
osource "/home/sassinak/Engineer-workspace/Engineer-sdk/zephyr/soc/oct/osd32mp15x/Kconfig"
osource "/home/sassinak/Engineer-workspace/Engineer-sdk/zephyr/soc/nxp/s32/Kconfig"
osource "/home/sassinak/Engineer-workspace/Engineer-sdk/zephyr/soc/nxp/rw/Kconfig"
osource "/home/sassinak/Engineer-workspace/Engineer-sdk/zephyr/soc/nxp/mcx/Kconfig"
osource "/home/sassinak/Engineer-workspace/Engineer-sdk/zephyr/soc/nxp/lpc/Kconfig"
osource "/home/sassinak/Engineer-workspace/Engineer-sdk/zephyr/soc/nxp/layerscape/Kconfig"
osource "/home/sassinak/Engineer-workspace/Engineer-sdk/zephyr/soc/nxp/kinetis/Kconfig"
osource "/home/sassinak/Engineer-workspace/Engineer-sdk/zephyr/soc/nxp/imxrt/Kconfig"
osource "/home/sassinak/Engineer-workspace/Engineer-sdk/zephyr/soc/nxp/imx/Kconfig"
osource "/home/sassinak/Engineer-workspace/Engineer-sdk/zephyr/soc/nuvoton/numicro/Kconfig"
osource "/home/sassinak/Engineer-workspace/Engineer-sdk/zephyr/soc/nuvoton/numaker/Kconfig"
osource "/home/sassinak/Engineer-workspace/Engineer-sdk/zephyr/soc/nuvoton/npcx/Kconfig"
osource "/home/sassinak/Engineer-workspace/Engineer-sdk/zephyr/soc/nuvoton/npcm/Kconfig"
osource "/home/sassinak/Engineer-workspace/Engineer-sdk/zephyr/soc/nordic/Kconfig"
osource "/home/sassinak/Engineer-workspace/Engineer-sdk/zephyr/soc/neorv32/Kconfig"
osource "/home/sassinak/Engineer-workspace/Engineer-sdk/zephyr/soc/native/inf_clock/Kconfig"
osource "/home/sassinak/Engineer-workspace/Engineer-sdk/zephyr/soc/microchip/sam/Kconfig"
osource "/home/sassinak/Engineer-workspace/Engineer-sdk/zephyr/soc/microchip/sam/sam_d5x_e5x/Kconfig"
osource "/home/sassinak/Engineer-workspace/Engineer-sdk/zephyr/soc/microchip/miv/Kconfig"
osource "/home/sassinak/Engineer-workspace/Engineer-sdk/zephyr/soc/microchip/mec/Kconfig"
osource "/home/sassinak/Engineer-workspace/Engineer-sdk/zephyr/soc/mediatek/mt8xxx/Kconfig"
osource "/home/sassinak/Engineer-workspace/Engineer-sdk/zephyr/soc/lowrisc/opentitan/Kconfig"
osource "/home/sassinak/Engineer-workspace/Engineer-sdk/zephyr/soc/litex/litex_vexriscv/Kconfig"
osource "/home/sassinak/Engineer-workspace/Engineer-sdk/zephyr/soc/ite/ec/Kconfig"
osource "/home/sassinak/Engineer-workspace/Engineer-sdk/zephyr/soc/intel/raptor_lake/Kconfig"
osource "/home/sassinak/Engineer-workspace/Engineer-sdk/zephyr/soc/intel/panther_lake/Kconfig"
osource "/home/sassinak/Engineer-workspace/Engineer-sdk/zephyr/soc/intel/lakemont/Kconfig"
osource "/home/sassinak/Engineer-workspace/Engineer-sdk/zephyr/soc/intel/intel_socfpga_std/Kconfig"
osource "/home/sassinak/Engineer-workspace/Engineer-sdk/zephyr/soc/intel/intel_socfpga/Kconfig"
osource "/home/sassinak/Engineer-workspace/Engineer-sdk/zephyr/soc/intel/intel_niosv/Kconfig"
osource "/home/sassinak/Engineer-workspace/Engineer-sdk/zephyr/soc/intel/intel_ish/Kconfig"
osource "/home/sassinak/Engineer-workspace/Engineer-sdk/zephyr/soc/intel/intel_adsp/Kconfig"
osource "/home/sassinak/Engineer-workspace/Engineer-sdk/zephyr/soc/intel/elkhart_lake/Kconfig"
osource "/home/sassinak/Engineer-workspace/Engineer-sdk/zephyr/soc/intel/atom/Kconfig"
osource "/home/sassinak/Engineer-workspace/Engineer-sdk/zephyr/soc/intel/apollo_lake/Kconfig"
osource "/home/sassinak/Engineer-workspace/Engineer-sdk/zephyr/soc/intel/alder_lake/Kconfig"
osource "/home/sassinak/Engineer-workspace/Engineer-sdk/zephyr/soc/infineon/cat3/Kconfig"
osource "/home/sassinak/Engineer-workspace/Engineer-sdk/zephyr/soc/infineon/cat1c/Kconfig"
osource "/home/sassinak/Engineer-workspace/Engineer-sdk/zephyr/soc/infineon/cat1b/Kconfig"
osource "/home/sassinak/Engineer-workspace/Engineer-sdk/zephyr/soc/infineon/cat1a/Kconfig"
osource "/home/sassinak/Engineer-workspace/Engineer-sdk/zephyr/soc/gd/gd32/Kconfig"
osource "/home/sassinak/Engineer-workspace/Engineer-sdk/zephyr/soc/gaisler/leon3/Kconfig"
osource "/home/sassinak/Engineer-workspace/Engineer-sdk/zephyr/soc/gaisler/gr716a/Kconfig"
osource "/home/sassinak/Engineer-workspace/Engineer-sdk/zephyr/soc/espressif/Kconfig"
osource "/home/sassinak/Engineer-workspace/Engineer-sdk/zephyr/soc/ene/kb1200/Kconfig"
osource "/home/sassinak/Engineer-workspace/Engineer-sdk/zephyr/soc/ene/kb106x/Kconfig"
osource "/home/sassinak/Engineer-workspace/Engineer-sdk/zephyr/soc/efinix/sapphire/Kconfig"
osource "/home/sassinak/Engineer-workspace/Engineer-sdk/zephyr/soc/cdns/xtensa_sample_controller/Kconfig"
osource "/home/sassinak/Engineer-workspace/Engineer-sdk/zephyr/soc/cdns/sample_controller32/Kconfig"
osource "/home/sassinak/Engineer-workspace/Engineer-sdk/zephyr/soc/cdns/dc233c/Kconfig"
osource "/home/sassinak/Engineer-workspace/Engineer-sdk/zephyr/soc/brcm/bcmvk/Kconfig"
osource "/home/sassinak/Engineer-workspace/Engineer-sdk/zephyr/soc/brcm/bcm2712/Kconfig"
osource "/home/sassinak/Engineer-workspace/Engineer-sdk/zephyr/soc/brcm/bcm2711/Kconfig"
osource "/home/sassinak/Engineer-workspace/Engineer-sdk/zephyr/soc/bflb/Kconfig"
osource "/home/sassinak/Engineer-workspace/Engineer-sdk/zephyr/soc/atmel/sam0/Kconfig"
osource "/home/sassinak/Engineer-workspace/Engineer-sdk/zephyr/soc/atmel/sam/Kconfig"
osource "/home/sassinak/Engineer-workspace/Engineer-sdk/zephyr/soc/aspeed/Kconfig"
osource "/home/sassinak/Engineer-workspace/Engineer-sdk/zephyr/soc/arm/Kconfig"
osource "/home/sassinak/Engineer-workspace/Engineer-sdk/zephyr/soc/arm/beetle/Kconfig"
osource "/home/sassinak/Engineer-workspace/Engineer-sdk/zephyr/soc/antmicro/myra/Kconfig"
osource "/home/sassinak/Engineer-workspace/Engineer-sdk/zephyr/soc/andestech/Kconfig"
osource "/home/sassinak/Engineer-workspace/Engineer-sdk/zephyr/soc/amd/acp_6_0/Kconfig"
osource "/home/sassinak/Engineer-workspace/Engineer-sdk/zephyr/soc/ambiq/Kconfig"
osource "/home/sassinak/Engineer-workspace/Engineer-sdk/zephyr/soc/aesc/Kconfig"
osource "/home/sassinak/Engineer-workspace/Engineer-sdk/zephyr/soc/adi/max32/Kconfig"
```
